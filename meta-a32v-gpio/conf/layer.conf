## meta-a32v-gpio/conf/layer.conf
```bitbake
BBPATH .= ":${LAYERDIR}"
BBFILES += "${LAYERDIR}/recipes-*/*/*.bb ${LAYERDIR}/recipes-*/*/*.bbappend ${LAYERDIR}/recipes-*/*/*/*.bb"
BBFILE_COLLECTIONS += "meta-a32v-gpio"
BBFILE_PATTERN_meta-a32v-gpio = "^${LAYERDIR}/"
BBFILE_PRIORITY_meta-a32v-gpio = "5"
LAYERSERIES_COMPAT_meta-a32v-gpio = "gatesgarth"
```
